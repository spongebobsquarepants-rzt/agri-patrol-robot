## a1_shijuedaohang/field_nav_external/Config.in
```kconfig
menu "field navigation"

source "$BR2_EXTERNAL_FIELD_NAV_PATH/package/field_nav_demo/Config.in"

endmenu
```

## a1_shijuedaohang/field_nav_external/package/field_nav_demo/Config.in
```kconfig
config BR2_PACKAGE_FIELD_NAV_DEMO
	bool "field_nav_demo"
	select BR2_PACKAGE_M1_SDK_LIB
	help
	  Field road segmentation and navigation line OSD demo for A1.

config BR2_FIELD_NAV_MODEL_PATH
	string "field navigation model path"
	default "app_assets/models/navroad_640x480.m1model"
	depends on BR2_PACKAGE_FIELD_NAV_DEMO
	help
	  Model path relative to /field_nav on the target rootfs.
```
